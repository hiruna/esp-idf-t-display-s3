## sdkconfig.defaults
```kconfig
# CPU
CONFIG_ESP_DEFAULT_CPU_FREQ_MHZ_240=y

# FreeRTOS
CONFIG_FREERTOS_HZ=1000

# SPI RAM
CONFIG_SPIRAM=y
CONFIG_SPIRAM_SPEED_80M=y
CONFIG_SPIRAM_MODE_OCT=y
CONFIG_IDF_EXPERIMENTAL_FEATURES=y
CONFIG_COMPILER_OPTIMIZATION_PERF=y
CONFIG_ESP32S3_DATA_CACHE_LINE_64B=y

# Partition Table
CONFIG_PARTITION_TABLE_SINGLE_APP_LARGE=y

# Flash
CONFIG_ESPTOOLPY_FLASH_MODE_AUTO_DETECT=n
CONFIG_ESPTOOLPY_FLASHMODE_QIO=y
CONFIG_ESPTOOLPY_FLASHSIZE_16MB=y

# PCLK frequency optimizations when Frame Buffer is allocated from the PSRAM and fetched by EDMA
# Refer to https://docs.espressif.com/projects/esp-idf/en/latest/esp32s3/api-reference/peripherals/lcd.html#bounce-buffer-with-single-psram-frame-buffer
CONFIG_SPIRAM_FETCH_INSTRUCTIONS=y
CONFIG_SPIRAM_RODATA=y
# Enabling the following configurations can help increase the PCLK frequency in the case when
# the Frame Buffer is allocated from the PSRAM and fetched by EDMA
# source: https://github.com/espressif/esp-idf/blob/master/examples/peripherals/lcd/i80_controller/sdkconfig.defaults.esp32s3
CONFIG_SPIRAM_XIP_FROM_PSRAM=y

# LVGL
CONFIG_LV_MEM_SIZE_KILOBYTES=128
CONFIG_LV_DEF_REFR_PERIOD=10
CONFIG_LV_CONF_SKIP=y
CONFIG_LV_USE_OBSERVER=y
CONFIG_LV_USE_SYSMON=y
CONFIG_LV_USE_PERF_MONITOR=y

CONFIG_LV_USE_CLIB_MALLOC=y
CONFIG_LV_USE_CLIB_STRING=y
CONFIG_LV_USE_CLIB_SPRINTF=y
CONFIG_LV_ATTRIBUTE_FAST_MEM_USE_IRAM=y
CONFIG_LV_USE_PERF_MONITOR=y
CONFIG_LV_COLOR_DEPTH_16=y

# LVGL Fonts
CONFIG_LV_FONT_MONTSERRAT_12=y
CONFIG_LV_FONT_MONTSERRAT_14=y
CONFIG_LV_FONT_MONTSERRAT_20=y
CONFIG_LV_FONT_MONTSERRAT_24=y

# Either set (CONFIG_LV_USE_DEMO_BENCHMARK and CONFIG_LV_USE_DEMO_WIDGETS) or CONFIG_LV_USE_DEMO_STRESS to y
# Commenting out both will display my lcd brightness example
CONFIG_LV_USE_DEMO_STRESS=n

# both options below are required for benchmark
CONFIG_LV_USE_DEMO_BENCHMARK=n
CONFIG_LV_USE_DEMO_WIDGETS=n
```
